## main/Kconfig.projbuild
```kconfig
menu "Wi-Fi Settings"
    config ESP_WIFI_SSID
        string "WiFi SSID"
        default "myssid"
        help
            SSID (network name) for the example to connect to.

    config ESP_WIFI_PASSWORD
        string "WiFi Password"
        default "mypassword"
        help
            WiFi password (WPA or WPA2) for the example to use.
    # config ESP_WIFI_CHANNEL
    #     int "WiFi Channel"
    #     range 1 13
    #     default 1
    #     help
    #         WiFi channel (network channel) for the example to use.

    config ESP_MAX_STA_CONN
        int "Maximal STA connections"
        default 4
        help
            Max number of the STA connects to AP.
endmenu

menu "Server Settings"
    config ESP_SUBMIT_URL
        string "Submit URL"
        default "http://example.com"
        help
            URL of the example to connect to.

    config ESP_SUBMIT_PASSWORD
        string "Submit Password"
        default "esp32"
        help
            Password for count API

    config ESP_SUBMIT_INTERVAL
        int "Submit Interval"
        default 10
        help
            Submit interval for count API

    config ESP_REQUEST_DEBUG
        bool "Request Debug"
        default n 
        help
            Request debug
endmenu
```
